## true_LS2K0300_Library/ls2k0300_linux_4.19/drivers/seekree_libraries/Kconfig
```kconfig
menuconfig SEEKFREE_KERNEL_DRIVER
	bool "seekfree kernel driver Support"
	help
	  seekfree kernel driver support.


if SEEKFREE_KERNEL_DRIVER

config ZF_DEVICE_IMU
	tristate "zf_device_imu660ra & zf_device_imu660rb & zf_device_imu963ra support"
	depends on CPU_LOONGSON3 || CPU_LOONGSON2K || CPU_LOONGSON64
	
	help
	  Automatically detect IMU660RA, IMU660RB and IMU963R modules, 
	  and initialize the IIO devices.

config ZF_DRIVER_ATIM 
	tristate "zf_driver_atim support"
	depends on CPU_LOONGSON3 || CPU_LOONGSON2K || CPU_LOONGSON64
	help
	  ATIM PWM framework driver for loongson2k.

config ZF_DRIVER_ENCODER
	tristate "zf_driver_encoder support"
	depends on CPU_LOONGSON3 || CPU_LOONGSON2K || CPU_LOONGSON64
	help
	  ATIM PWM framework driver for loongson2k.
	  
config ZF_DRIVER_GPIO 
	tristate "zf_driver_gpio support"
	depends on CPU_LOONGSON3 || CPU_LOONGSON2K || CPU_LOONGSON64
	help
	  GPIO framework driver for loongson2k.

	  Turning this option on will initialize the GPIO device 
	  in the device tree as a device file. 
	  You only need to read and write this file to operate the GPIO.


config ZF_DRIVER_GTIM 
	tristate "zf_driver_gtim support"
	depends on CPU_LOONGSON3 || CPU_LOONGSON2K || CPU_LOONGSON64
	help
	  ATIM PWM framework driver for loongson2k.

	  To compile this driver as a module, choose M here: the module
	  will be called pwm-ls-atim.

config ZF_DRIVER_PWM
	tristate "zf_driver_pwm support"
	depends on CPU_LOONGSON3 || CPU_LOONGSON2K || CPU_LOONGSON64
	help
	  ATIM PWM framework driver for loongson2k.

	  Turning this option on initializes 
	  the PWM device in the device tree as a device file. 
	  You only need to read and write 
	  this file to operate the PWM device.

endif
```
